## main/Kconfig.projbuild
```kconfig
menu "Telemetria hidraulica"
    config TANK_SELF_TEST
        bool "Ejecutar pruebas de calculo al arrancar"
        default n
    config TANK_ADC_ADDRESS
        hex "Direccion I2C ADS1115 (ADDR a GND: 0x48)"
        range 0x48 0x4b
        default 0x48
    config TANK_ACQUISITION_MS
        int "Intervalo de adquisicion (ms)"
        range 100 10000
        default 1000
endmenu
```

## sdkconfig.defaults
```kconfig
CONFIG_IDF_TARGET="esp32c6"
CONFIG_ESPTOOLPY_FLASHSIZE_8MB=y
CONFIG_ESP_CONSOLE_USB_SERIAL_JTAG=y
CONFIG_FREERTOS_HZ=1000
CONFIG_ZB_ENABLED=y
CONFIG_ZB_ZCZR=y
CONFIG_ZB_RADIO_NATIVE=y
# CONFIG_ZB_SDK_1xx is not set
```
